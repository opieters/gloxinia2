/*
 * File:   dac.c
 * Author: opieters
 *
 * Created on June 29, 2018, 10:22 AM
 */

#include <xc.h>
#include <dsp.h>
#include "dac.h"
#include <math.h>
#include <device_configuration.h>
#include <adc.h>
#include "planalta.h"

__eds__ fractional dac_buffer[MAX_N_UPDATES_PER_PERIOD] __attribute__((space(dma), eds));


static fractional const planalta_fs_50khz_dac_data[128] __attribute__((space(auto_psv))) = {
    0x0004, 0x0004, 0x0004, 0x0005, 0x0005, 0x0005, 0x0005, 0x0006, 0x0006, 
    0x0006, 0x0006, 0x0007, 0x0007, 0x0007, 0x0007, 0x0007, 0x0008, 0x0008, 
    0x0008, 0x0008, 0x0008, 0x0008, 0x0008, 0x0009, 0x0009, 0x0009, 0x0009, 
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    0x0004, 0x0004
};
static fractional const planalta_fs_20khz_dac_data[200]__attribute__((space(auto_psv))) = {
    0x0007, 0x0007, 0x0008, 0x0008, 0x0008, 0x0008, 0x0008, 0x0009, 0x0009, 
    0x0009, 0x0009, 0x000a, 0x000a, 0x000a, 0x000a, 0x000b, 0x000b, 0x000b, 
    0x000b, 0x000b, 0x000c, 0x000c, 0x000c, 0x000c, 0x000c, 0x000d, 0x000d, 
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    0x0006, 0x0007
};
static fractional const planalta_fs_10khz_dac_data[400] __attribute__((space(auto_psv))) = {
    0x0007, 0x0007, 0x0007, 0x0007, 0x0008, 0x0008, 0x0008, 0x0008, 0x0008, 
    0x0008, 0x0008, 0x0008, 0x0008, 0x0009, 0x0009, 0x0009, 0x0009, 0x0009, 
    0x0009, 0x0009, 0x0009, 0x000a, 0x000a, 0x000a, 0x000a, 0x000a, 0x000a, 
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    0x0006, 0x0007, 0x0007, 0x0007
};
static fractional const planalta_fs_5khz_dac_data[800] __attribute__((space(auto_psv))) = {
    0x0007, 0x0007, 0x0007, 0x0007, 0x0007, 0x0007, 0x0007, 0x0007, 0x0008, 
    0x0008, 0x0008, 0x0008, 0x0008, 0x0008, 0x0008, 0x0008, 0x0008, 0x0008, 
    0x0008, 0x0008, 0x0008, 0x0008, 0x0008, 0x0008, 0x0008, 0x0009, 0x0009, 
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    0x0006, 0x0007, 0x0007, 0x0007, 0x0007, 0x0007, 0x0007, 0x0007
};

static fractional const planalta_fs_2khz_dac_data[800] __attribute__((space(auto_psv))) = {
    0x0013, 0x0013, 0x0013, 0x0013, 0x0014, 0x0014, 0x0014, 0x0014, 0x0014, 
    0x0014, 0x0015, 0x0015, 0x0015, 0x0015, 0x0015, 0x0015, 0x0016, 0x0016, 
    0x0016, 0x0016, 0x0016, 0x0016, 0x0016, 0x0017, 0x0017, 0x0017, 0x0017, 
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    0x0012, 0x0012, 0x0012, 0x0012, 0x0012, 0x0013, 0x0013, 0x0013
};
static fractional const planalta_fs_1khz_dac_data[800] __attribute__((space(auto_psv))) = {
    0x0027, 0x0027, 0x0028, 0x0028, 0x0028, 0x0029, 0x0029, 0x0029, 0x002a, 
    0x002a, 0x002a, 0x002a, 0x002b, 0x002b, 0x002b, 0x002c, 0x002c, 0x002c, 
    0x002d, 0x002d, 0x002d, 0x002e, 0x002e, 0x002e, 0x002e, 0x002f, 0x002f, 
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    0x0024, 0x0025, 0x0025, 0x0025, 0x0026, 0x0026, 0x0026, 0x0027
};
static fractional const planalta_fs_500hz_dac_data[800] __attribute__((space(auto_psv))) = {
    0x004f, 0x0050, 0x0050, 0x0051, 0x0052, 0x0052, 0x0053, 0x0053, 0x0054, 
    0x0055, 0x0055, 0x0056, 0x0057, 0x0057, 0x0058, 0x0058, 0x0059, 0x005a, 
    0x005a, 0x005b, 0x005c, 0x005c, 0x005d, 0x005d, 0x005e, 0x005f, 0x005f, 
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    0x004a, 0x004b, 0x004b, 0x004c, 0x004c, 0x004d, 0x004e, 0x004e
};
static fractional const planalta_fs_200hz_dac_data[800] __attribute__((space(auto_psv))) = {
    0x00c7, 0x00c9, 0x00ca, 0x00cc, 0x00cd, 0x00cf, 0x00d0, 0x00d2, 0x00d4, 
    0x00d5, 0x00d7, 0x00d8, 0x00da, 0x00db, 0x00dd, 0x00df, 0x00e0, 0x00e2, 
    0x00e3, 0x00e5, 0x00e6, 0x00e8, 0x00e9, 0x00eb, 0x00ec, 0x00ee, 0x00f0, 
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    0x00ba, 0x00bc, 0x00be, 0x00bf, 0x00c1, 0x00c2, 0x00c4, 0x00c5
};
static fractional const planalta_fs_100hz_dac_data[800] __attribute__((space(auto_psv))) = {
    0x018f, 0x0192, 0x0195, 0x0198, 0x019c, 0x019f, 0x01a2, 0x01a5, 0x01a8, 
    0x01ab, 0x01ae, 0x01b2, 0x01b5, 0x01b8, 0x01bb, 0x01be, 0x01c1, 0x01c4, 
    0x01c7, 0x01ca, 0x01ce, 0x01d1, 0x01d4, 0x01d7, 0x01da, 0x01dd, 0x01e0, 
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    0x0176, 0x0179, 0x017c, 0x017f, 0x0182, 0x0186, 0x0189, 0x018c
};
static fractional const planalta_fs_50hz_dac_data[800] __attribute__((space(auto_psv))) = {
    0x031f, 0x0325, 0x032c, 0x0332, 0x0338, 0x033e, 0x0345, 0x034b, 0x0351, 
    0x0358, 0x035e, 0x0364, 0x036a, 0x0371, 0x0377, 0x037d, 0x0383, 0x0389, 
    0x0390, 0x0396, 0x039c, 0x03a2, 0x03a9, 0x03af, 0x03b5, 0x03bb, 0x03c1, 
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    0x02ed, 0x02f3, 0x02f9, 0x0300, 0x0306, 0x030c, 0x0312, 0x0319
};
static fractional const planalta_fs_20hz_dac_data[800] __attribute__((space(auto_psv))) = {
    0x07cf, 0x07df, 0x07ee, 0x07fe, 0x080e, 0x081e, 0x082d, 0x083d, 0x084d, 
    0x085c, 0x086c, 0x087c, 0x088b, 0x089b, 0x08aa, 0x08ba, 0x08ca, 0x08d9, 
    0x08e9, 0x08f8, 0x0908, 0x0917, 0x0927, 0x0936, 0x0946, 0x0955, 0x0965, 
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    0x0751, 0x0761, 0x0771, 0x0780, 0x0790, 0x07a0, 0x07b0, 0x07bf
};
static fractional const planalta_fs_10hz_dac_data[800] __attribute__((space(auto_psv))) = {
    0x0f9f, 0x0fbe, 0x0fde, 0x0ffd, 0x101d, 0x103c, 0x105b, 0x107b, 0x109a, 
    0x10ba, 0x10d9, 0x10f8, 0x1117, 0x1137, 0x1156, 0x1175, 0x1194, 0x11b3, 
    0x11d3, 0x11f2, 0x1211, 0x1230, 0x124f, 0x126e, 0x128d, 0x12ab, 0x12ca, 
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    0x0ea4, 0x0ec3, 0x0ee3, 0x0f02, 0x0f21, 0x0f41, 0x0f60, 0x0f80
};

void init_sine_pwm_buffer(planalta_config_t* config, __eds__ fractional* buffer){
    uint16_t i, j, duty_cycle_index, n_possible_duty_cylces;
    const uint16_t length = config->dac_config.signal_period;
    float duty_cycle_value;
    float c_offset, p_offset, sine_value;
    
    n_possible_duty_cylces = MIN(MAX_N_CYCLES_PER_PERIOD, config->dac_config.pwm_period);
    
    // calculate actual duty cycles
    for(i = 0; i < length; i++){
        p_offset = 1.0;
        sine_value = (1.0+sin(2.0 * PI * i / length)) / 2.0;
        duty_cycle_index = 0;
        // find the closest PWM value
        for(j = 0; j < n_possible_duty_cylces; j++){
            // calculate possible duty cycles (not uniform!)
            if(j == 0){
                duty_cycle_value = 0.0;
            } else { 
                if(j == n_possible_duty_cylces-1) {
                    duty_cycle_value = 1.0;
                }
                else {
                    duty_cycle_value = 1.0 * (j+1) / (n_possible_duty_cylces);
                }
            }
            c_offset = duty_cycle_value - sine_value;
            c_offset = c_offset>=0?c_offset:-c_offset;
            if(c_offset < p_offset){
                p_offset = c_offset;
                duty_cycle_index = j;
            }
        }
        buffer[i] = duty_cycle_index;
        //buffer[i] = n_possible_duty_cylces-1;
    }
}


void init_buffer_calibration(double duty_cycle, struct planalta_config_s* config, __eds__ fractional* buffer){
    uint16_t i, j, duty_cycle_index = 0, n_possible_duty_cylces;
    const uint16_t length = config->dac_config.signal_period;
    float c_offset, p_offset = 1.0, current_duty_cycle;
    
    n_possible_duty_cylces = MIN(MAX_N_CYCLES_PER_PERIOD, config->dac_config.pwm_period);
    
    // find the closest PWM value
    for(j = 0; j < n_possible_duty_cylces; j++){
        // calculate possible duty cycles (not uniform!)
        if(j == 0){
            current_duty_cycle = 0.0;
        } else { 
            if(j == n_possible_duty_cylces-1) {
                current_duty_cycle = 1.0;
            }
            else {
                current_duty_cycle = 1.0 * (j+1) / (n_possible_duty_cylces);
            }
        }
        c_offset = current_duty_cycle - duty_cycle;
        c_offset = c_offset>=0?c_offset:-c_offset;
        if(c_offset < p_offset){
            p_offset = c_offset;
            duty_cycle_index = j;
        }
    }
    
    // calculate actual duty cycles
    for(i = 0; i < length; i++){
        buffer[i] = duty_cycle_index;
    }
}

void init_oc(struct planalta_config_s* config){
    // initialise Output Compare Module in PWM mode
    OC2CON1bits.OCM = 0b000;              // Disable Output Compare Module
    OC2R = (config->dac_config.pwm_period)/2-1;     // Write the duty cycle for the PWM pulse
    OC2RS = (config->dac_config.pwm_period) -1;     // Write the PWM frequency
    OC2CON1bits.OCTSEL = 0b111;           // Select peripheral clock as output compare time base
    
    _OC2IF = 0;                           // clear the OC1 interrupt flag
    _OC2IE = 0;                           // disable OC1 interrupt
    
    OC2CON2bits.SYNCSEL=0b11111;          // no sync event
}

void init_dac_timer(struct planalta_config_s* config){
    // configure timer to trigger DMA OC updates
    T4CONbits.TON = 0; 
    
    T4CONbits.TCS = 0; // use internal instruction cycle as clock source
    T4CONbits.TGATE = 0; // disable gated timer
    T4CONbits.TCKPS = 0b00; // prescaler 1:1
    TMR4 = 0; // clear timer register
    
    PR4 = config->dac_config.pwm_period-1;
    
    _T4IF = 0; // clear interrupt flag
    _T4IE = 0; // disable interrupt
}

void start_dac(void){
    OC2CON1bits.OCM = 0b110;
    T4CONbits.TON = 1;
}

void stop_dac(void){
    T4CONbits.TON = 0;
    OC2CON1bits.OCM = 0b000;
    DMA0CONbits.CHEN = 0;
}

void init_dac_dma(struct planalta_config_s* config){
    // configure DMA0
    DMA0CONbits.SIZE = 0; // word data transfer
    DMA0CONbits.HALF = 0; // interrupt when all data is transfered
    DMA0CONbits.NULLW = 0; // normal operation
    DMA0CONbits.DIR = 1; // read from RAM to peripheral
    DMA0CONbits.AMODE = 0; // register indirect with post increment
    DMA0CONbits.MODE = 0; // continuous no ping-pong mode
    
    DMA0REQbits.IRQSEL = DMAREQ_IRQ_TMR4; // select timer 4 as trigger source
    
    DMA0STAL = __builtin_dmaoffset(dac_buffer); // buffer A
    DMA0STAH = 0x0000;
    
    DMA0PAD = (volatile unsigned int) &OC2R; // peripheral address
    
    DMA0CNT = config->dac_config.signal_period - 1;
    
    _DMA0IF = 0; // clear interrupt flag
    _DMA0IE = 0; // disable interrupt
    
    DMA0CONbits.CHEN = 1; // enable DMA channel
}

void init_dac(struct planalta_config_s* config, bool calibration){
    size_t i;
    __psv__ fractional const* dac_data_buffer = planalta_fs_50khz_dac_data;
    
    stop_dac();
    
    // update DAC config based on filter choice
    switch(config->operation_mode){
        case PLANALTA_LIA_F_50KHZ:
            config->dac_config.pwm_period = 10;
            config->dac_config.signal_period = 128;
            break;
        case PLANALTA_LIA_F_25KHZ:
            config->dac_config.pwm_period = 10;
            config->dac_config.signal_period = 256;
            break;
        case PLANALTA_LIA_F_10KHZ:
            config->dac_config.pwm_period = 16;
            config->dac_config.signal_period = 400;
            break;
        case PLANALTA_LIA_F_5KHZ:
            config->dac_config.pwm_period = 16;
            config->dac_config.signal_period = 800;
            break;
        case PLANALTA_FS:
            switch(config->sweep_frequency){
                case PLANALTA_FS_FREQ_50KHZ:
                    config->dac_config.pwm_period = 10;
                    config->dac_config.signal_period = 128;
                    dac_data_buffer = planalta_fs_50khz_dac_data;
                    break;
                case PLANALTA_FS_FREQ_20KHZ:
                    config->dac_config.pwm_period = 16;
                    config->dac_config.signal_period = 200;
                    dac_data_buffer = planalta_fs_20khz_dac_data;
                    break;
                case PLANALTA_FS_FREQ_10KHZ:
                    config->dac_config.pwm_period = 16;
                    config->dac_config.signal_period = 400;
                    dac_data_buffer = planalta_fs_10khz_dac_data;
                    break;
                case PLANALTA_FS_FREQ_5KHZ:
                    config->dac_config.pwm_period = 16;
                    config->dac_config.signal_period = 800;
                    dac_data_buffer = planalta_fs_5khz_dac_data;
                    break;
                case PLANALTA_FS_FREQ_2KHZ:
                    config->dac_config.pwm_period = 40;
                    config->dac_config.signal_period = 800;
                    dac_data_buffer = planalta_fs_2khz_dac_data;
                    break;
                case PLANALTA_FS_FREQ_1KHZ:
                    config->dac_config.pwm_period = 80;
                    config->dac_config.signal_period = 800;
                    dac_data_buffer = planalta_fs_1khz_dac_data;
                    break;
                case PLANALTA_FS_FREQ_500HZ:
                    config->dac_config.pwm_period = 160;
                    config->dac_config.signal_period = 800;
                    dac_data_buffer = planalta_fs_500hz_dac_data;
                    break;
                case PLANALTA_FS_FREQ_200HZ:
                    config->dac_config.pwm_period = 400;
                    config->dac_config.signal_period = 800;
                    dac_data_buffer = planalta_fs_200hz_dac_data;
                    break;
                case PLANALTA_FS_FREQ_100HZ:
                    config->dac_config.pwm_period = 800;
                    config->dac_config.signal_period = 800;
                    dac_data_buffer = planalta_fs_100hz_dac_data;
                    break;
                case PLANALTA_FS_FREQ_50HZ:
                    config->dac_config.pwm_period = 1600;
                    config->dac_config.signal_period = 800;
                    dac_data_buffer = planalta_fs_50hz_dac_data;
                    break;
                case PLANALTA_FS_FREQ_20HZ:
                    config->dac_config.pwm_period = 4000;
                    config->dac_config.signal_period = 800;
                    dac_data_buffer = planalta_fs_20hz_dac_data;
                    break;
                case PLANALTA_FS_FREQ_10HZ:
                    config->dac_config.pwm_period = 8000;
                    config->dac_config.signal_period = 800;
                    dac_data_buffer = planalta_fs_10hz_dac_data;
                    break;
                default:
                    report_error("dac: no support for this configuration.");
                    break;
            }
            break;
        default:
            report_error("dac: no support for this configuration.");
            break;
    }
    
    // initialise buffer with duty cycle values
    if(calibration){
        // initialise Output Compare Module in PWM mode
        OC2CON1bits.OCM = 0b000;              // Disable Output Compare Module
        OC2R = 0;     // Write the duty cycle for the PWM pulse
        OC2RS = 3;     // Write the PWM frequency
        OC2CON1bits.OCTSEL = 0b111;           // Select peripheral clock as output compare time base

        _OC2IF = 0;                           // clear the OC1 interrupt flag
        _OC2IE = 0;                           // disable OC1 interrupt

        OC2CON2bits.SYNCSEL=0b11111;          // no sync event

         OC2CON1bits.OCM = 0b110;
    } else {
        switch(config->operation_mode){
            case PLANALTA_LIA_F_50KHZ:
            case PLANALTA_LIA_F_25KHZ:
            case PLANALTA_LIA_F_10KHZ:
            case PLANALTA_LIA_F_5KHZ:
                init_sine_pwm_buffer(config, dac_buffer);
                break;
            case PLANALTA_FS:
                for(i = 0; i < config->dac_config.signal_period; i++){
                    dac_buffer[i] = dac_data_buffer[i];
                }
                break;
            default:
                break;
        }
        
        init_oc(config);

        init_dac_timer(config);

        init_dac_dma(config);

        start_dac();
    }
    
    
}

// allocate interrupt routines to make sure there is no duplicate HW use
void __attribute__((__interrupt__,no_auto_psv)) _DMA0Interrupt(void){
    _DMA0IF = 0;              // Clear the DMA0 Interrupt Flag
}

void __attribute__((__interrupt__, no_auto_psv)) _OC2Interrupt(void){
    _OC2IF = 0;
}

void __attribute__((__interrupt__, no_auto_psv)) _T4Interrupt(void){
    _T4IF = 0;
}

